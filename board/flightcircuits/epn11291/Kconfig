## board/flightcircuits/epn11291/Kconfig
```kconfig
if TARGET_EPN11291

config SYS_BOARD
	default "epn11291"

config SYS_VENDOR
	default "flightcircuits"

config SYS_SOC
	default "am33xx"

config SYS_CONFIG_NAME
	default "epn11291"


endif
```

## configs/epn11291_defconfig
```kconfig
CONFIG_ARM=y
# added CONFIG_ARCH_CPU_INIT RWL
CONFIG_ARCH_CPU_INIT=y
CONFIG_ARCH_OMAP2PLUS=y

CONFIG_SPL_LIBCOMMON_SUPPORT=y
CONFIG_SPL_LIBGENERIC_SUPPORT=y
# CONFIG_ENV_OFFSET=0x0
CONFIG_AM33XX=y
# CONFIG_TARGET_AM335X_EVM is not set
CONFIG_TARGET_EPN11921=y
CONFIG_SPL_MMC_SUPPORT=y
CONFIG_SPL_SERIAL_SUPPORT=y
CONFIG_SPL=y
CONFIG_BANNER_PRINT=y
CONFIG_SPL_ENV_SUPPORT=y

CONFIG_TPL_BANNER_PRINT=y
CONFIG_SPL_USE_TINY_PRINTF=n

# This section for debug serial port
CONFIG_DEBUG_UART_BOARD_INIT=y
CONFIG_DEBUG_UART_BASE=0x44e09000
CONFIG_DEBUG_UART_CLOCK=48000000
CONFIG_DEBUG_UART=y
CONFIG_DEBUG_UART_OMAP=y
# CONFIG_DEBUG_UART_NS16550=y
CONFIG_DEBUG_UART_SHIFT=2
CONFIG_DEBUG_UART_ANNOUNCE=y

## make sure there is enough room in SYS_MALLOC_F_LEN for the CONFIG_CONSOLE_RECORD_OUT_SIZE
CONFIG_SYS_MALLOC_F_LEN=4000
## The value below is hex (1000 = 1<<12)
CONFIG_CONSOLE_RECORD_OUT_SIZE=1000
CONFIG_CONSOLE_RECORD=y

CONFIG_SPL_ETH_SUPPORT=y
CONFIG_SPL_NET_SUPPORT=y
CONFIG_SPL_NET_VCI_STRING="EP11291 U-Boot SPL"

CONFIG_CMD_DHCP=y

CONFIG_SYS_VENDOR="flightcircuits"
CONFIG_SYS_BOARD="epn11291"
CONFIG_SYS_CONFIG_NAME="epn11291"
CONFIG_LOCALVERSION="-FlightCircuits-EPN11291"
# CONFIG_LOCALVERSION_AUTO is not set

CONFIG_SPL_GPIO_SUPPORT=y
# CONFIG_SPL_NAND_SUPPORT is not set
CONFIG_DISTRO_DEFAULTS=y
CONFIG_BOOTDELAY=2
CONFIG_BOOTCOMMAND="if test ${boot_fit} -eq 1; then run update_to_fit; fi; run findfdt; run init_console; run envboot; run distro_bootcmd"
# CONFIG_SYS_CONSOLE_INFO_QUIET is not set
CONFIG_DEFAULT_FDT_FILE="epn11291"
CONFIG_DEFAULT_DEVICE_TREE="epn11291"
CONFIG_VERSION_VARIABLE=y
CONFIG_ARCH_MISC_INIT=y
# XXXTODO rwl CONFIG_SPL_MUSB_NEW_SUPPORT=y
# CONFIG_SPL_OS_BOOT is not set
CONFIG_SPL_YMODEM_SUPPORT=y
CONFIG_SYS_I2C=n
CONFIG_SYS_I2C_OMAP24XX=n
CONFIG_SPL_I2C_SUPPORT=n
CONFIG_SYS_PROMPT="U-Boot# "
CONFIG_AUTOBOOT_KEYED=y
CONFIG_AUTOBOOT_PROMPT="Press SPACE to abort autoboot in %d seconds\n"
CONFIG_AUTOBOOT_DELAY_STR="d"
CONFIG_AUTOBOOT_STOP_STR=" "
CONFIG_CMD_SPL=y
CONFIG_CMD_GPIO=y
CONFIG_CMD_GPT=y
CONFIG_CMD_MMC=y
CONFIG_CMD_BTRFS=y
CONFIG_EFI_LOADER=n

CONFIG_SPL_WATCHDOG_SUPPORT=n
CONFIG_WATCHDOG=n
## CONFIG_HW_WATCHDOG=n
CONFIG_SPL_WATCHDOG_SUPPORT=n
CONFIG_WATCHDOG_TIMEOUT_MSECS=60000

CONFIG_MMC_OMAP_HS=y
CONFIG_MMC_OMAP_HS_ADMA=y
# CONFIG_CMD_FLASH is not set
# CONFIG_ENV_IS_IN_FAT is not set
CONFIG_ENV_OFFSET_REDUND=0x280000
CONFIG_OF_LIST="epn11291"
CONFIG_ENV_IS_IN_EXT4=y
CONFIG_ENV_EXT4_INTERFACE="mmc"
CONFIG_ENV_EXT4_DEVICE_AND_PART="1:1"
CONFIG_ENV_EXT4_FILE="/boot/uboot.env"
CONFIG_ENV_VARS_UBOOT_RUNTIME_CONFIG=y
CONFIG_ENV_OVERWRITE=y
CONFIG_ENV_IS_IN_MMC=n
###CONFIG_SYS_MMC_ENV_DEV=1
###CONFIG_SYS_MMC_ENV_PART=0

CONFIG_BOOTCOUNT_LIMIT=y
CONFIG_DFU_TFTP=n
CONFIG_DFU_MMC=n
CONFIG_DFU_RAM=n
CONFIG_ENV_SIZE=0x20000
# XXXTODO rwl CONFIG_USB_FUNCTION_FASTBOOT=y
## CONFIG_FASTBOOT_FLASH=y
## CONFIG_FASTBOOT_FLASH_MMC_DEV=1
## CONFIG_FASTBOOT_CMD_OEM_FORMAT=y
CONFIG_RGMII=y
CONFIG_PHY_MARVELL=y
CONFIG_DRIVER_TI_CPSW=y

CONFIG_OF_CONTROL=y
CONFIG_SPL_BUILD=n
CONFIG_OF_EMBED=n
CONFIG_OF_BOARD=n
CONFIG_OF_SEPARATE=y
CONFIG_DM_MDIO=y
CONFIG_DM_MDIO_MUX=y
# ADDED DM_SERIAL
CONFIG_DM_SERIAL=y
CONFIG_SPL_DM_SERIAL=y
CONFIG_DM_ETH=y
CONFIG_SPL_ETH_DEVICE="cpsw_emac0"
CONFIG_DM_MMC=y
CONFIG_SPL_DM_MMC=y
CONFIG_MMC_QUIRKS=y
CONFIG_OF_LIBFDT=n
CONFIG_SPL_LOG=y
CONFIG_SYS_MMCSD_RAW_MODE_U_BOOT_USE_PARTITION
CONFIG_SYS_MMCSD_RAW_MODE_U_BOOT_SECTOR=300
### CONFIG_SYS_MMCSD_RAW_MODE_U_BOOT_PARTITION=1
CONFIG_TIMER=y
CONFIG_OMAP_TIMER=y
CONFIG_LZO=y
CONFIG_FIT_SIGNATURE=y
CONFIG_FIT_VERBOSE=y
### CONFIG_SYS_EXTRA_OPTIONS="EMMC_BOOT"
CONFIG_SYS_REDUNDAND_ENVIRONMENT=y
CONFIG_SYS_RELOC_GD_ENV_ADDR=y
CONFIG_BOOTP_SEND_HOSTNAME=y
CONFIG_MISC=y
CONFIG_EMMC_BOOT=y
```
